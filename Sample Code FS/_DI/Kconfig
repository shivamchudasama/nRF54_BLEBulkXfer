## _DI/Kconfig
```kconfig
#*******************************************************************************
#
# Application Kconfig (KCONFIG_ROOT, set in the top-level CMakeLists.txt)
#
#*******************************************************************************
menu "Application"

config DS_HEX_DUMP
	bool "Print every byte of each received hex segment on the log"
	help
	  When enabled, the data store prints each CRC-verified segment as
	  "0xAAAAAAAA: xx xx ..." lines, 16 bytes per line, framed by SEG start
	  and SEG end lines. STORED is sent only after the last line, and the
	  next segment is rejected until then, so a 64 KiB segment holds the
	  upload for several seconds. Use it for debugging.

	  When disabled, each segment is reported with a single
	  "SEG addr=... len=... crc=..." line and STORED follows at once.

config PROV_WIPE_HOLD_MS
	int "Hold time of the provisioning wipe button (ms)"
	default 5000
	range 500 60000
	help
	  Holding DK Button 0 this long wipes the provisioning credentials
	  (device key, CSR, CA and device certificate) and generates a fresh
	  key and CSR, as the DEPROVISION message does. Releasing the button
	  earlier does nothing.

menu "File system manager"

choice FSMGR_FLASH_INTERFACE
	prompt "External flash interface"
	default FSMGR_FLASH_IF_SPI
	help
	  The interface of the external NOR flash that holds the FAT volume
	  (FLASH_DISK). Selected by _DI/conf/flash_<if>.conf together with its
	  devicetree overlay (root CMakeLists.txt, FLASH_IF); used for the mount
	  log line.

config FSMGR_FLASH_IF_SPI
	bool "SPI NOR (jedec,spi-nor on spi00)"

config FSMGR_FLASH_IF_SQSPI
	bool "sQSPI soft peripheral on the FLPR core (jedec,mspi-nor)"

endchoice

config FSMGR_BUFFERED_WRITE
	bool "Collect written data into larger flash writes"
	help
	  The File System Manager collects the data of successive write
	  commands in a RAM buffer and writes it to the file in
	  FSMGR_WRITE_BUFFER_SIZE pieces. Disable it to write every command's
	  data directly.

config FSMGR_WRITE_BUFFER_SIZE
	int "Write buffer size (bytes)"
	depends on FSMGR_BUFFERED_WRITE
	range 240 4096
	default 512
	help
	  Size of the RAM buffer used by FSMGR_BUFFERED_WRITE. Larger values
	  mean fewer flash writes and more RAM.

config FSMGR_STACK_SIZE
	int "File System Manager thread stack size"
	default 4096

config FSMGR_PRIORITY
	int "File System Manager thread priority"
	default 10
	help
	  Keep it below the BulkXfer engine (priority 5), so flash writes
	  never delay the link.

config FSMGR_QUEUE_DEPTH
	int "File System Manager message queue depth"
	default 8
	range 2 64

config FS_CMD
	bool "File commands over BLE (appTypes 0x40-0x4F)"
	default y
	help
	  Lets the host (GUI Files page, bulkxfer_client.py fs) create, list,
	  read, write and delete files on the external flash. Like the hex
	  upload, it runs on the unauthenticated host link, so turn it off in
	  production builds.

endmenu

menu "Device pairing"

config PAIR_TIMEOUT_MS
	int "Time limit of a pairing run (ms)"
	default 60000
	range 10000 600000
	help
	  A pairing run (from the host's START to PAIRED) that takes longer
	  fails with error TIMEOUT: the peer link is dropped and the host sees
	  FAILED in the pairing status.

config PAIR_CONNECT_TIMEOUT_MS
	int "Time limit to reach the peer device (ms)"
	default 30000
	range 5000 600000
	help
	  The peripheral advertises directed to the central, and the central
	  scans for the peripheral, for at most this long before the run fails
	  with error TIMEOUT.

endmenu

menu "Device certificate subject (CSR)"

config CSR_SUBJ_C
	string "Country (C)"
	default "IN"
	help
	  Two-letter country code placed in the CSR subject. The CN is not
	  configurable: it is a UUIDv5 derived from the hardware device ID.

config CSR_SUBJ_ST
	string "State or province (ST)"
	default "Maharashtra"

config CSR_SUBJ_L
	string "Locality (L)"
	default "Pune"

config CSR_SUBJ_O
	string "Organization (O)"
	default "Bajaj Auto Technology Limited"

config CSR_SUBJ_OU
	string "Organizational unit (OU)"
	default "IS Team"

endmenu

endmenu

source "Kconfig.zephyr"
```
