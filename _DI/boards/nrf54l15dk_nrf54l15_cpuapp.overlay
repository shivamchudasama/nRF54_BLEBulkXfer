/*
 * Console / log UART (uart20, routed to the DK's interface MCU VCOM).
 * 921600 baud (the J-Link OB VCOM tops out at 1 Mbaud); RTS/CTS
 * are wired to the interface MCU, so enable flow control to avoid overruns.
 */
&uart20 {
	current-speed = <921600>;
	hw-flow-control;
};
